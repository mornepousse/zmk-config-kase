## boards/shields/kase/Kconfig.defconfig
```kconfig
# Copyright (c) 2025
# SPDX-License-Identifier: MIT

if SHIELD_KASE_DONGLE

config ZMK_KEYBOARD_NAME
    default "KaSe"

config ZMK_SPLIT_ROLE_CENTRAL
    default y

config ZMK_SPLIT_BLE_CENTRAL_PERIPHERALS
    default 2

endif

if SHIELD_KASE_LEFT || SHIELD_KASE_RIGHT

config ZMK_SPLIT_ROLE_CENTRAL
    default n

endif

if SHIELD_KASE_LEFT || SHIELD_KASE_RIGHT || SHIELD_KASE_DONGLE

config ZMK_SPLIT
    default y

endif
```

## boards/shields/kase/Kconfig.shield
```kconfig
# Copyright (c) 2025 The ZMK Contributors
# SPDX-License-Identifier: MIT

config SHIELD_KASE_DONGLE
	def_bool $(shields_list_contains,kase_dongle)

config SHIELD_KASE_LEFT
	def_bool $(shields_list_contains,kase_left)

config SHIELD_KASE_RIGHT
	def_bool $(shields_list_contains,kase_right)
```
